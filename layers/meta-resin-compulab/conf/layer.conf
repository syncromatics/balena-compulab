## layers/meta-resin-compulab/conf/layer.conf
```bitbake
BBPATH .= ":${LAYERDIR}"

BBFILES += "${LAYERDIR}/recipes-*/*/*.bb \
            ${LAYERDIR}/recipes-*/*/*.bbappend"

BBFILE_COLLECTIONS += "resin-compulab"
BBFILE_PATTERN_resin-compulab := "^${LAYERDIR}/"
BBFILE_PRIORITY_resin-compulab = "1337"
```
